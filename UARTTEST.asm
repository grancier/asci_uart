

FALSE	EQU	0
TRUE	EQU	1
;========== Z180 Internal Interrupt Vectors ========

; The following vectors are offsets from the value 
; loaded in IL, the Interrupt Vector Low register.

VINT1	EQU	0	;External INT-1 pin
VINT2	EQU	2	;External INT-2 pin
VPRT0	EQU	4	;Timer 0
VPRT1	EQU	6	;Timer 1
VDMA0	EQU	8	;DMA Ch-0
VDMA1	EQU	0ah	;DMA Ch-1
VCSIO	EQU	0ch	;Clocked serial I/O
VASC0	EQU	0eh	;Asynch. comms. Ch-0
VASC1	EQU	10h	;Asynch. comms. Ch-1

;========== Z180 System Control Registers ==========

;NB These registers may be relocated to multiples of
; 40H, by setting the IO Control Register (ICR = 3FH)
; The addresses below are valid with ICR=0 (else they
; are offsets from the ICR base value).

;ASCI REGISTERS
CNTLA0  EQU     00H     ;ASCI CONTROL REG A CH0
CNTLA1  EQU     01H     ;ASCI CONTROL REG A CH1
CNTLB0  EQU     02H     ;ASCI CONTROL REG B CH0
CNTLB1  EQU     03H     ;ASCI CONTROL REG B CH1
STAT0   EQU     04H     ;ASCI STATUS REG CH0
STAT1   EQU     05H     ;ASCI STATUS REG CH1
TDR0    EQU     06H     ;ASCI TX DATA REG CH0
TDR1    EQU     07H     ;ASCI TX DATA REG CH1
RDR0    EQU     08H     ;ASCI RX DATA REG CH0
RDR1    EQU     09H     ;ASCI RX DATA REG CH1
BRK0    EQU     12H     ;BREAK CONTROL REG CH0
BRK1    EQU     13H     ;BREAK CONTROL REG CH1

CNTLA0  EQU     00H
CNTLA1  EQU     01H
CNTLB0  EQU     02H
CNTLB1  EQU     03H
STAT0   EQU     04H
STAT1   EQU     05H
TDR0    EQU     06H
TDR1    EQU     07H
RDR0    EQU     08H
RDR1    EQU     09H
ASEXT0  EQU  12H
ASEXT1  EQU  13H
ASTC0L  EQU  1AH
ASTC0H  EQU  1BH
ASTC1L  EQU  1CH
ASTC1H  EQU  1DH
CNTR  EQU  0AH
TRDR  EQU  0BH
TMDR0L  EQU  0CH
TMDR0H  EQU  0DH
RLDR0L  EQU  0EH
RLDR0H  EQU  0FH
TCR     EQU  10H
TMDR1L  EQU  14H
TMDR1H  EQU  15H
RLDR1L  EQU  16H
RLDR1H  EQU  17H
FRC  EQU  18H
CMR  EQU  1EH
CCR  EQU  1FH
SAR0L  EQU  20H
SAR0H  EQU  21H
SAR0B  EQU  22H
DAR0L  EQU  23H
DAR0H  EQU  24H
DAR0B  EQU  25H
BCR0L  EQU  26H
BCR0H  EQU  27H
MAR1L  EQU  28H
MAR1H  EQU  29H
MAR1B  EQU  2aH
IAR1L  EQU  2bH
IAR1H  EQU  2cH
IAR1B  EQU  2dH
BCR1L  EQU  2eH
BCR1H  EQU  2fH
DSTAT  EQU  30H
DMODE  EQU  31H
DCNTL  EQU  32H
IL     EQU  33H
ITC  EQU  34H
RCR  EQU  36H
CBR  EQU  38H
BBR  EQU  39H
CBAR    EQU  3AH
OMCR    EQU  3EH
ICR     EQU  3FH
CNTLA0_MPE  EQU  80H
CNTLA0_RE  EQU  40H
CNTLA0_TE  EQU  20H
CNTLA0_RTS0  EQU  10H
CNTLA0_MPBR  EQU  08H
CNTLA0_EFR  EQU  08H
CNTLA0_MODE_MASK  EQU  07H
CNTLA0_MODE_8P2  EQU  07H
CNTLA0_MODE_8P1  EQU  06H
CNTLA0_MODE_8N2  EQU  05H
CNTLA0_MODE_8N1  EQU  04H
CNTLA0_MODE_7P2  EQU  03H
CNTLA0_MODE_7P1  EQU  02H
CNTLA0_MODE_7N2  EQU  01H
CNTLA0_MODE_7N1  EQU  00H
CNTLA1_MPE  EQU  80H
CNTLA1_RE  EQU  40H
CNTLA1_TE  EQU  20H
CNTLA1_CKA1D  EQU  10H
CNTLA1_MPBR  EQU  08H
CNTLA1_EFR  EQU  08H
CNTLA1_MODE_MASK  EQU  07H
CNTLA1_MODE_8P2  EQU  07H
CNTLA1_MODE_8P1  EQU  06H
CNTLA1_MODE_8N2  EQU  05H
CNTLA1_MODE_8N1  EQU  04H
CNTLA1_MODE_7P2  EQU  03H
CNTLA1_MODE_7P1  EQU  02H
CNTLA1_MODE_7N2  EQU  01H
CNTLA1_MODE_7N1  EQU  00H
CNTLB0_MPBT     EQU  80H
CNTLB0_MP       EQU  40H
CNTLB0_CTS      EQU  20H
CNTLB0_PS       EQU  20H
CNTLB0_PEO      EQU  10H
CNTLB0_DR       EQU  08H
CNTLB0_SS_MASK  EQU  07H
CNTLB0_SS_EXT   EQU  07H
CNTLB0_SS_DIV_64  EQU  06H
CNTLB0_SS_DIV_32  EQU  05H
CNTLB0_SS_DIV_16  EQU  04H
CNTLB0_SS_DIV_8  EQU  03H
CNTLB0_SS_DIV_4  EQU  02H
CNTLB0_SS_DIV_2  EQU  01H
CNTLB0_SS_DIV_1  EQU  00H
CNTLB1_MPBT     EQU  80H
CNTLB1_MP       EQU  40H
CNTLB1_CTS      EQU  20H
CNTLB1_PS       EQU  20H
CNTLB1_PEO      EQU  10H
CNTLB1_DR       EQU  08H
CNTLB1_SS_MASK  EQU  07H
CNTLB1_SS_EXT   EQU  07H
CNTLB1_SS_DIV_64  EQU  06H
CNTLB1_SS_DIV_32  EQU  05H
CNTLB1_SS_DIV_16  EQU  04H
CNTLB1_SS_DIV_8  EQU  03H
CNTLB1_SS_DIV_4  EQU  02H
CNTLB1_SS_DIV_2  EQU  01H
CNTLB1_SS_DIV_1  EQU  00H
STAT0_RDRF      EQU  80H
STAT0_OVRN      EQU  40H
STAT0_PE        EQU  20H
STAT0_FE        EQU  10H
STAT0_RIE       EQU  08H
STAT0_DCD0      EQU  04H
STAT0_TDRE      EQU  02H
STAT0_TIE       EQU  01H
STAT1_RDRF      EQU  80H
STAT1_OVRN      EQU  40H
STAT1_PE        EQU  20H
STAT1_FE        EQU  10H
STAT1_RIE       EQU  08H
STAT1_CTS1E     EQU  04H
STAT1_TDRE      EQU  02H
STAT1_TIE       EQU  01H
CNTR_EF         EQU  80H
CNTR_EIE        EQU  40H
CNTR_RE         EQU  20H
CNTR_TE         EQU  10H
CNTR_SS_MASK    EQU  07H
CNTR_SS_EXT     EQU  07H
CNTR_SS_DIV_1280    EQU  06H
CNTR_SS_DIV_640     EQU  05H
CNTR_SS_DIV_320     EQU  04H
CNTR_SS_DIV_160     EQU  03H
CNTR_SS_DIV_80      EQU  02H
CNTR_SS_DIV_40      EQU  01H
CNTR_SS_DIV_20      EQU  00H
TCR_TIF1            EQU  80H
TCR_TIF0  EQU  40H
TCR_TIE1  EQU  20H
TCR_TIE0  EQU  10H
TCR_TOC1  EQU  08H
TCR_TOC0  EQU  04H
TCR_TDE1  EQU  02H
TCR_TDE0  EQU  01H
DSTAT_DE1  EQU  80H
DSTAT_DE0  EQU  40H
DSTAT_DWE1  EQU  20H
DSTAT_DWE0  EQU  10H
DSTAT_DIE1  EQU  08H
DSTAT_DIE0  EQU  04H
DSTAT_DME  EQU  01H
DMODE_DM1  EQU  20H
DMODE_DM0  EQU  10H
DMODE_SM1  EQU  08H
DMODE_SM0  EQU  04H
DMODE_MMOD  EQU  02H
DCNTL_MWI1  EQU  80H
DCNTL_MWI0  EQU  40H
DCNTL_IWI1  EQU  20H
DCNTL_IWI0  EQU  10H
DCNTL_DMS1  EQU  08H
DCNTL_DMS0  EQU  04H
DCNTL_DIM1  EQU  02H
DCNTL_DIM0  EQU  01H
ITC_TRAP    EQU  80H
ITC_UFO     EQU  40H
ITC_ITE2  EQU  04H
ITC_ITE1  EQU  02H
ITC_ITE0  EQU  01H
RCR_REFE  EQU  80H
RCR_REFW  EQU  40H
RCR_CYC1  EQU  02H
RCR_CYC0  EQU  01H
OMCR_M1E  EQU  80H
OMCR_M1TE   EQU  40H
OMCR_IOC    EQU  20H
CMR_X2      EQU  80H
CMR_LN_XTAL  EQU  40H
CCR_XTAL_X2  EQU  80H
CCR_STANDBY  EQU  40H
CCR_BREXT   EQU  20H
CCR_LNPHI   EQU  10H
CCR_IDLE    EQU  08H
CCR_LNIO    EQU  04H
CCR_LNCPUCTL    EQU  02H
CCR_LNAD        EQU  01H

;CSI/O Registers
cntr    EQU     0ah     ;CSI/O Control Reg
trdr    EQU     0bh     ;CSI/O TX/RX Data Reg

ccr     EQU     1fh     ;CPU control reg.
intype  EQU     0dfh    ;Interrupt edge/pin mux reg.
wsgcs   EQU     0d8h    ;Wait-State Generator CS
enh182  EQU     0d9h    ;Z80182 Enhancements Reg
pinmux  EQU     0dfh    ;Interrupt Edge/Pin Mux Reg
ramubr  EQU     0e6h    ;RAM End Boundary
ramlbr  EQU     0e7h    ;RAM Start Boundary
rombr   EQU     0e8h    ;ROM Boundary

romend	EQU		0e8h
ramstart	EQU	0e7h
ramend		EQU	0e6h

FIFOCTL EQU     0E9H    ;FIFO CONTROL REG
RTOTC   EQU     0EAH    ;RX TIME-OUT TIME CONST
TTOTC   EQU     0EBH    ;TX TIME-OUT TIME CONST
FCR     EQU     0ECH    ;FIFO REGISTER
SCR     EQU     0EFH    ;SYSTEM PIN CONTROL
RBR     EQU     0F0H    ;MIMIC RX BUFFER REG
THR     EQU     0F0H    ;MIMIC TX HOLDING REG
IER     EQU     0F1H    ;INTERRUPT ENABLE REG
LCR     EQU     0F3H    ;LINE CONTROL REG
MCR     EQU     0F4H    ;MODEM CONTROL REG
LSR     EQU     0F5H    ;LINE STATUS REG
MSR     EQU     0F6H    ;MODEM STATUS REG
MSCR    EQU     0F7H    ;MIMIC SCRATCH REG
DLATL   EQU     0F8H    ;DIVISOR LATCH LS
DLATM   EQU     0F9H    ;DIVISOR LATCH MS
TTCR    EQU     0FAH    ;TX TIME CONSTANT
RTCR    EQU     0FBH    ;RX TIME CONSTANT
IVEC    EQU     0FCH    ;MIMIC INTERRUPT VECTOR
MIMIE   EQU     0FDH    ;MIMIC INTERRUPT ENABLE REG
IUSIP   EQU     0FEH    ;MIMIC INTERRUPT UNDER-SERVICE REG
MMCR    EQU     0FFH    ;MIMIC MASTER CONTROL REG

;DMA REGISTERS
SAR0L   EQU     20H     ;DMA SOURCE ADDR REG CH0-LOW
SAR0H   EQU     21H     ;DMA SOURCE ADDR REG CH0-HIGH
SAR0B   EQU     22H     ;DMA SOURCE ADDR REG CH0-B
DAR0L   EQU     23H     ;DMA DESTN  ADDR REG CH0-LOW
DAR0H   EQU     24H     ;DMA DESTN  ADDR REG CH0-HIGH
DAR0B   EQU     25H     ;DMA DESTN  ADDR REG CH0-B
BCR0L   EQU     26H     ;DMA BYTE COUNT REG CH0-LOW
BCR0H   EQU     27H     ;DMA BYTE COUNT REG CH0-HIGH
MAR1L   EQU     28H     ;DMA MEMORY ADDR REG CH1-LOW
MAR1H   EQU     29H     ;DMA MEMORY ADDR REG CH1-HIGH
MAR1B   EQU     2AH     ;DMA MEMORY ADDR REG CH1-B
IAR1L   EQU     2BH     ;DMA I/O ADDR REG CH1-LOW
IAR1H   EQU     2CH     ;DMA I/O ADDR REG CH1-HIGH
BCR1L   EQU     2EH     ;DMA BYTE COUNT REG CH1-LOW
BCR1H   EQU     2FH     ;DMA BYTE COUNT REG CH1-HIGH
DSTAT   EQU     30H     ;DMA STATUS REG
DMODE   EQU     31H     ;DMA MODE REG
DCNTL   EQU     32H     ;DMA/WAIT CONTROL REG


;SYSTEM CONTROL REGISTERS
IL      EQU     33H     ;INT VECTOR LOW REG
ITC     EQU     34H     ;INT/TRAP CONTROL REG
RCR     EQU     36H     ;REFRESH CONTROL REG
CBR     EQU     38H     ;MMU COMMON BASE REG
BBR     EQU     39H     ;MMU BANK BASE REG
CBAR    EQU     3AH     ;MMU COMMON/BANK AREA REG
OMCR    EQU     3EH     ;OPERATION MODE CONTROL REG
ICR     EQU     3FH     ;I/O CONTROL REG

;--- CHARACTER DEVICE SECTION ---


        ; THE FOLLOWING TWO DEVICES RESULT IN NON-STANDARD DATA RATES
        ; WITH THE STANDARD 16.00 MHZ CRYSTAL IN THE P112.  IF A MORE
        ; "STANDARD" CRYSTAL IS USED (12.288, 18.432, 24.576 MHZ ETC)
        ; IS USED, THE PORTS BECOME USABLE.
        ;   DRIVER CODE FOR ASCI0 AND ASCI1 INCLUDES AN OPTION FOR
        ; ASSEMBLING POLLED OR INTERRUPT-DRIVEN BUFFERED INPUT.
        ; SELECT THE DESIRED OPTION FOR ASCI0 WITH THE BUFFA0 FLAG,
        ; AND BUFFA1 FOR ASCI1.
ASCI_0  EQU FALSE       ; INCLUDE ASCI0 DRIVER?
BUFFA0  EQU FALSE       ;   USE BUFFERED ASCI0 INPUT DRIVER?
ASCI_1  EQU FALSE       ; INCLUDE ASCI1 DRIVER?
BUFFA1  EQU FALSE       ;   USE BUFFERED ASCI1 INPUT DRIVER?

QSIZE   EQU 32      ; SIZE OF INTERRUPT TYPEAHEAD BUFFERS (IF USED)
                ; ..MUST BE 2^N WITH N<8
RTSCTS  EQU FALSE       ; INCLUDE RTS/CTS CODE ON SERIAL OUTPUTS?
XONOFF  EQU FALSE ; INCLUDE XON/XOFF HANDSHAKING IN SERIAL LINES?


;***********************************
;*  UART TEST PROGRAM              *
;*                                 *
;***********************************

.ORG 00000H
  
;------------------------------------------------------------------------------
; START OF COMMON AREA 1 DRIVER - ASCI0 FUNCTIONS
;------------------------------------------------------------------------------

ASCI0RXBUFFER:   DEFS 256   ; SPACE FOR THE RX BUFFER
ASCI0TXBUFFER:   DEFS 256   ; SPACE FOR THE TX BUFFER

ASCI0TXCOUNT:    DEFB 0                 ; SPACE FOR TX BUFFER MANAGEMENT
ASCI0TXIN:       DEFW ASCI0TXBUFFER     ; NON-ZERO ITEM IN BSS SINCE IT'S INITIALIZED ANYWAY
ASCI0TXOUT:      DEFW ASCI0TXBUFFER     ; NON-ZERO ITEM IN BSS SINCE IT'S INITIALIZED ANYWAY
ASCI0TXLOCK:     DEFB $FE               ; LOCK FLAG FOR TX EXCLUSION

ASCI0RXCOUNT:    DEFB 0                 ; SPACE FOR RX BUFFER MANAGEMENT
ASCI0RXIN:       DEFW ASCI0RXBUFFER     ; NON-ZERO ITEM IN BSS SINCE IT'S INITIALIZED ANYWAY
ASCI0RXOUT:      DEFW ASCI0RXBUFFER     ; NON-ZERO ITEM IN BSS SINCE IT'S INITIALIZED ANYWAY
ASCI0RXLOCK:     DEFB $FE               ; LOCK FLAG FOR RX EXCLUSION


STAT0_RDRF EQU 80H

INIT_UART:
   ; INITIALISE THE ASCI0
                               ; LOAD THE DEFAULT ASCI CRT CONFIGURATION
                               ; BAUD = 115200 8N1
                               ; RECEIVE ENABLED
                               ; TRANSMIT ENABLED
                               ; RECEIVE INTERRUPT ENABLED
                               ; TRANSMIT INTERRUPT DISABLED

   LD A,CNTLA0_RE|CNTLA0_TE|CNTLA0_MODE_8N1
   OUT0 (CNTLA0),A             ; OUTPUT TO THE ASCI0 CONTROL A REG

                               ; PHI / PS / SS / DR = BAUD RATE
                               ; PHI = 36.864MHZ
                               ; BAUD = 115200 = 36864000 / 10 / 2 / 16
                               ; PS 0, SS_DIV_2, DR 0
   LD A,CNTLB0_SS_DIV_2
   OUT0    (CNTLB0),A          ; OUTPUT TO THE ASCI0 CONTROL B REG

   LD A,STAT0_RIE              ; RECEIVE INTERRUPT ENABLED
   OUT0 (STAT0),A              ; OUTPUT TO THE ASCI0 STATUS REG
  


ASM_ASCI0_INTERRUPT:
   PUSH AF
   PUSH HL
                               ; START DOING THE RX STUFF
   IN A,(STAT0)               ; LOAD THE ASCI0 STATUS REGISTER
   TST STAT0_RDRF              ; TEST WHETHER WE HAVE RECEIVED ON ASCI0
   JR Z,ASCI0_TX_CHECK         ; IF NOT, GO CHECK FOR BYTES TO TRANSMIT



ASCI0_TX_END:
   POP HL
   POP AF
   EI
   RET

CNTLA0_MODE_8N1 EQU 04H

;******************************************************************
;INIT_UART
;Function: Initialize the UART to BAUD Rate 9600 (1.8432 MHz clock input)
;DLAB A2 A1 A0 Register
;0    0  0  0  Receiver Buffer (read),
;              Transmitter Holding
;              Register (write)
;0    0  0  1  Interrupt Enable
;X    0  1  0  Interrupt Identification (read)
;X    0  1  0  FIFO Control (write)
;X    0  1  1  Line Control
;X    1  0  0  MODEM Control
;X    1  0  1  Line Status
;X    1  1  0  MODEM Status
;X    1  1  1  Scratch
;1    0  0  0  Divisor Latch
;              (least significant byte)
;1    0  0  1  Divisor Latch
;              (most significant byte)
;******************************************************************



SETUP:  LD SP, 0FFFFFH
       LD A,00FH
       OUT (003H),A

LOOP:   LD A,0FFH
       OUT (002H),A
       CALL WAIT
       LD A,000H
       OUT (002H),A
       CALL WAIT
       JP LOOP

WAIT:   LD BC, 00000010H
OUTER:  LD DE, 10000100H
INNER:  DEC DE
       LD A, D
       OR E
       JP NZ, INNER
       DEC BC
       LD A, B
       OR C
       JP NZ, OUTER
       RET


MAIN_LOOP:   
			IN      A,(CNTLA0)        ; Get the line status register's contents
			BIT     5,A            ; Test BIT, it will be set if the UART is ready
			JP      Z,MAIN_LOOP    
			LD      A,41H          ; Load acumulator with "A" Character
			OUT     (TDR0),A        ; Send "A" Character through the UART
			JP      MAIN_LOOP

.END
